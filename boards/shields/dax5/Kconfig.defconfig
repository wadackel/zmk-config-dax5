## boards/shields/dax5/Kconfig.defconfig
```kconfig
if SHIELD_DAX5_R

config ZMK_KEYBOARD_NAME
  default "dax5_R"

config ZMK_SPLIT_ROLE_CENTRAL
  default y

endif

if SHIELD_DAX5_L

config ZMK_KEYBOARD_NAME
  default "dax5_L"

endif

if SHIELD_DAX5_R || SHIELD_DAX5_L

config ZMK_SPLIT
  default y

endif
```

## boards/shields/dax5/Kconfig.shield
```kconfig
config SHIELD_DAX5_R
  def_bool $(shields_list_contains,dax5_R)

config SHIELD_DAX5_L
  def_bool $(shields_list_contains,dax5_L)
```

## config/west.yml
```yaml
manifest:
  remotes:
    - name: zmkfirmware
      url-base: https://github.com/zmkfirmware
    - name: cormoran
      url-base: https://github.com/cormoran
    - name: caksoylar
      url-base: https://github.com/caksoylar
    - name: sekigon-gonnoc
      url-base: https://github.com/sekigon-gonnoc
    - name: wadackel
      url-base: https://github.com/wadackel
  projects:
    - name: zmk
      remote: cormoran
      revision: 1fc72aaff7a42bd533c1f4c9b3f23c5317c745f4  # main+custom-studio-protocol as of 2026-07-22 (ZMK main + custom Studio RPC)
      import: app/west.yml
    - name: zmk-driver-paw3222
      remote: sekigon-gonnoc
      revision: df652881be2520bde4f64ab6ca35e4c5708f4f9b  # main as of 2026-06-15, builds against ZMK main
    - name: zmk-rgbled-widget
      remote: caksoylar
      revision: e6b467792a1dabef8cfa5c9fd26bfefc9c16662b  # main as of 2026-07-09
    - name: zmk-dax-modules
      remote: wadackel
      revision: 4751585588c33bc5e95b9e4ba854920d4ae7997d  # main as of 2026-10-20
  self:
    path: config
```
