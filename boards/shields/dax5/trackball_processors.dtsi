// The trackball's runtime-tunable input processors. Kept apart from the shield overlay so the
// native_sim tests under tests/ exercise these exact definitions.

#include <dt-bindings/input/input-event-codes.h>

/ {
  // Runtime-tunable replacements for the fixed transform/scaler processors
  // (zmk-dax-modules' dax,input-processor-pointer). The properties are the
  // defaults; a settings app changes them through the dax settings of the
  // `dax_pointer` owner, one slot per processor in this order.
  //
  // `tb_pointer` owns the sensor orientation. The processor inverts by the axis
  // an event had before the swap, so `xy-swap; x-invert;` is what
  // `zip_xy_transform (XY_SWAP | Y_INVERT)` used to do. It runs first in the
  // Scroll chain too, so its scale also multiplies scrolling.
  tb_pointer: tb_pointer {
    compatible = "dax,input-processor-pointer";
    display-name = "Pointer";
    x-codes = <INPUT_REL_X>;
    y-codes = <INPUT_REL_Y>;
    xy-swap;
    x-invert;
    track-remainders;
    #input-processor-cells = <0>;
  };

  // Replaces `zip_scroll_transform (Y_INVERT)` + `zip_scroll_scaler 1 64` on the Scroll layer.
  tb_scroll: tb_scroll {
    compatible = "dax,input-processor-pointer";
    display-name = "Scroll";
    x-codes = <INPUT_REL_HWHEEL>;
    y-codes = <INPUT_REL_WHEEL>;
    y-invert;
    scale-divisor = <64>;
    track-remainders;
    #input-processor-cells = <0>;
  };
};
